## u-boot-2017.09/board/jz2440/Kconfig
```kconfig
if TARGET_JZ2440

config SYS_BOARD
	default "jz2440"

config SYS_CONFIG_NAME
	default "jz2440"

endif
```

## u-boot-2017.09/configs/jz2440_defconfig
```kconfig
CONFIG_ARM=y
CONFIG_TARGET_JZ2440=y
CONFIG_NAND=y
CONFIG_CMD_NAND=y
CONFIG_SPL=y
CONFIG_SPL_FRAMEWORK=y
CONFIG_SPL_SERIAL_SUPPORT=y
CONFIG_SPL_NAND_SUPPORT=y
CONFIG_SPL_BUILD=y
CONFIG_SPL_GPIO_SUPPORT=y
CONFIG_S3C2440_GPIO=y
CONFIG_SPL_LIBGENERIC_SUPPORT=y
CONFIG_CMD_IMLS=n
CONFIG_NET_RANDOM_ETHADDR=y
```
